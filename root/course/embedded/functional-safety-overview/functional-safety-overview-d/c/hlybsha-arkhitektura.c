// Дві незалежні гілки читають ту саму фізичну величину РІЗНИМИ шляхами
// (різні давачі, різні АЦП). Розбіжність або самовиявлена помилка → safe state.
// Це кістяк схеми 1oo2D: два канали, кожен із діагностикою, спільна звірка.

typedef struct {
    float value;      // виміряне значення каналу
    bool  valid;      // канал сам вважає своє значення достовірним
} chan_reading_t;

#define ALT_MAX_DISAGREE_M  3.0f   // допустима розбіжність каналів, м
#define DISAGREE_LIMIT      3      // скільки поспіль розбіжностей терпимо

void safety_cycle_1oo2d(void) {
    chan_reading_t a = channel_a_read();   // напр. барометр + АЦП №1
    chan_reading_t b = channel_b_read();   // напр. GPS-висота + інший тракт

    // 1. Кожен канал спершу перевіряє САМ СЕБЕ (це і піднімає SFF: виявлена
    //    відмова каналу — це λ_DD, а не прихована λ_DU).
    if (!a.valid || !b.valid) {
        enter_safe_state(HAZARD_CHAN_SELFTEST);   // хоч один не довіряє собі
        return;
    }

    // 2. Перехресна звірка: два незалежні шляхи МУСЯТЬ сходитися.
    //    Розходяться — один із них бреше, а який саме, ми не знаємо,
    //    тож єдина безпечна відповідь — не вірити жодному.
    if (fabsf(a.value - b.value) > ALT_MAX_DISAGREE_M) {
        if (++disagree_count >= DISAGREE_LIMIT) {  // не смикаємось на одиничний збій
            enter_safe_state(HAZARD_CHAN_DISAGREE);
            return;
        }
    } else {
        disagree_count = 0;   // згода — скидаємо лічильник розбіжностей
    }

    // 3. Канали згодні й певні себе — керуємо за узгодженим значенням.
    float alt_m = 0.5f * (a.value + b.value);   // середнє двох згідних каналів
    update_control(alt_m);

    // 4. «Я живий» незалежному сторожу — той сам скине систему, якщо цикл завис.
    watchdog_feed();
}
