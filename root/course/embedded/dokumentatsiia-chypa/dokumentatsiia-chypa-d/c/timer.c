#include "timer.h"

#include "rcc.h"
#include "stm32f4_regs.h"

/* Лічильник мілісекунд. volatile обов'язковий: значення змінює обробник
 * переривання, а головний цикл читає його — без volatile компілятор має
 * повне право зчитати змінну один раз до циклу й більше не звертатися. */
static volatile uint32_t s_ticks;

/* Проміжна частота лічильника: один такт = одна мікросекунда.
 * Так ARR читається як період у мікросекундах, і арифметика перевіряється очима. */
#define TIMER_TICK_HZ 1000000UL
#define TIMER_RATE_HZ 1000UL

timer_status_t timer_1khz_start(uint32_t timer_clock_hz)
{
    /* --- Перевірка арифметики ДО того, як щось записано в залізо ---------
     * Дільник рахуємо на папері й повертаємо помилку, якщо частота не дає
     * рівно 1 кГц. Мовчазне округлення тут коштувало б плаваючого дрейфу
     * годинника, який шукають тижнями. */
    if (timer_clock_hz < TIMER_TICK_HZ) {
        return TIMER_ERR_CLOCK_TOO_SLOW;
    }
    if ((timer_clock_hz % TIMER_TICK_HZ) != 0UL) {
        return TIMER_ERR_CLOCK_NOT_EXACT;
    }

    const uint32_t psc = (timer_clock_hz / TIMER_TICK_HZ) - 1UL;
    if (psc > 0xFFFFUL) {
        return TIMER_ERR_PRESCALER_RANGE;
    }

    const uint32_t arr = (TIMER_TICK_HZ / TIMER_RATE_HZ) - 1UL; /* 999 */

    /* --- Крок 1. Тактування (Clock Gating) ------------------------------ */
    rcc_apb1_enable(RCC_APB1ENR_TIM2EN);

    /* Скидання блоку прибирає все, що могло лишитися від попереднього
     * запуску чи від завантажувача: жодних припущень про вміст регістрів. */
    rcc_apb1_reset(RCC_APB1RSTR_TIM2RST);

    /* --- Крок 2. Виводи ---
     * Цьому режиму зовнішні ніжки не потрібні: таймер рахує всередині
     * кристала й піднімає лише лінію переривання до NVIC. Матриця
     * альтернативних функцій знадобилася б для ШІМ або захоплення входу. */

    /* --- Крок 3. Конфігурація при ВИМКНЕНОМУ блоці ----------------------- */
    TIM2->CR1  = 0UL;               /* CEN = 0: лічильник стоїть            */
    TIM2->DIER = 0UL;               /* жодних переривань під час набору     */
    TIM2->PSC  = psc;
    TIM2->ARR  = arr;
    TIM2->CNT  = 0UL;

    /* URS = 1: подію оновлення генерує лише переповнення лічильника.
     * Без цього біта програмна подія UG нижче теж підняла б UIF і NVIC
     * викликав би обробник ще до першої реальної мілісекунди. */
    TIM2->CR1 |= TIM_CR1_URS;

    /* PSC і ARR — буферовані регістри: залізо переносить записане у робочі
     * тіньові копії лише за подією оновлення (RM0090 §18.4.11). Доки такої
     * події не було, таймер рахує зі старим предільником. Тому подію
     * генеруємо самі — біт UG у регістрі EGR (тип доступу WO). */
    TIM2->EGR = TIM_EGR_UG;

    /* UG усе одно виставив UIF (URS обмежує лише запит переривання, не
     * прапорець). Скидаємо його ДО дозволу переривання.
     *
     * TIMx_SR має тип доступу rc_w0: запис нуля скидає біт, запис одиниці
     * не робить нічого. Тому пишемо одиниці всюди, крім UIF, — сусідні
     * прапорці лишаються недоторканими, а циклу read-modify-write, у
     * якому залізо могло б втратити щойно піднятий прапорець, немає. */
    TIM2->SR = ~TIM_SR_UIF;

    /* --- Крок 4. Дозволи й активація ------------------------------------ */
    TIM2->DIER |= TIM_DIER_UIE;

    /* NVIC — це вже Programming Manual, а не Reference Manual:
     * пріоритет і дозвіл вектора живуть у регістрах ядра. */
    NVIC_IPR[TIM2_IRQn] = (uint8_t)(0x08U << 4); /* середній пріоритет */
    NVIC_ISER[TIM2_IRQn / 32U] = 1UL << (TIM2_IRQn % 32U);

    /* Дозвіл переривання в NVIC мусить бути видимим ядру до першого
     * спрацьовування, інакше перший запит загубиться. */
    DSB();
    ISB();

    s_ticks = 0UL;
    TIM2->CR1 |= TIM_CR1_CEN;   /* поїхали */

    return TIMER_OK;
}

void timer_stop(void)
{
    TIM2->CR1  &= ~TIM_CR1_CEN;
    TIM2->DIER &= ~TIM_DIER_UIE;

    /* Запит міг уже дійти до NVIC, поки ми знімали дозвіл у самому таймері:
     * знімаємо дозвіл вектора й гасимо прапорець, щоб обробник не викликався
     * після зупинки. */
    NVIC_ICER[TIM2_IRQn / 32U] = 1UL << (TIM2_IRQn % 32U);
    TIM2->SR = ~TIM_SR_UIF;
    DSB();
}

uint32_t timer_ticks(void)
{
    /* 32-бітне вирівняне читання на Cortex-M атомарне — блокувати
     * переривання заради нього не треба. */
    return s_ticks;
}

void TIM2_IRQHandler(void)
{
    const uint32_t sr = TIM2->SR;

    /* Перевіряємо і прапорець, і дозвіл: один вектор обслуговує всі події
     * таймера, а прапорець без дозволу не наш — його чекає інший код. */
    if ((sr & TIM_SR_UIF) != 0UL && (TIM2->DIER & TIM_DIER_UIE) != 0UL) {
        TIM2->SR = ~TIM_SR_UIF;     /* rc_w0: нуль скидає, одиниця не діє */

        ++s_ticks;

        /* Запис у периферію ще «летить» шиною APB, коли ядро вже виходить
         * з обробника. Без бар'єра NVIC устигає побачити прапорець досі
         * піднятим і викликає обробник удруге — класичне подвійне
         * спрацьовування, описане в PM0214 §4.2.5. */
        DSB();
    }
}
