#include <stdint.h>
#include <stdbool.h>

// Повідомлення завширшки кілька слів — саме той «багатобітний вантаж»,
// який не можна читати посеред запису.
typedef struct {
    uint32_t timestamp;
    uint32_t value;
    uint16_t channel;
    uint16_t flags;
} sample_t;

// Спільний «мейлбокс» між ISR та головним циклом.
// ВАЖЛИВО: прапорці — volatile, бо їх пише один контекст, а читає інший;
// без volatile компілятор має право закешувати їх у регістрі й ніколи
// не перечитати з пам'яті — і цикл зависне назавжди.
static volatile bool     mbx_req = false;   // ISR → main: «дані готові»
static volatile bool     mbx_ack = false;   // main → ISR: «прийняв»
static          sample_t mbx_data;          // самі дані (під захистом прапорців)

// ── Домен A: обробник переривання від давача ────────────────────────────
// Викликається апаратно, асинхронно до головного циклу.
void sensor_isr(void) {
    // Якщо попереднє слово ще не забрали (req уже стоїть) — не чіпаємо
    // мейлбокс, інакше перепишемо дані з-під носа читача. Пропускаємо відлік
    // (або, за потреби, накопичуємо окремо) — але НІКОЛИ не рвемо обмін.
    if (mbx_req)
        return;

    // Фаза 0: наповнюємо дані ДО підняття прапорця.
    mbx_data.timestamp = hw_read_timer();
    mbx_data.value     = hw_read_adc();
    mbx_data.channel   = hw_read_channel();
    mbx_data.flags     = hw_read_flags();

    // Бар'єр пам'яті: усі записи в mbx_data мусять лягти в пам'ять
    // ДО того, як стане видимим mbx_req. Інакше процесор чи компілятор
    // можуть переставити порядок, і читач побачить req=1 над недописаними даними.
    __asm volatile ("" ::: "memory");   // компіляторний бар'єр
    // (на багатоядерних — тут потрібен апаратний бар'єр, напр. DMB на ARM)

    mbx_req = true;                     // фаза 1: піднімаємо запит
    // Далі ISR виходить; підтвердження перевіримо наступного разу.
}

// ── Домен B: головний цикл ──────────────────────────────────────────────
void main_loop(void) {
    for (;;) {
        // Чекаємо запит. mbx_req — volatile, тож справді перечитуємо щоразу.
        if (mbx_req && !mbx_ack) {
            // req стоїть → дані повністю дописані (їх поставили ДО req,
            // а бар'єр не дав переставити). Беремо структуру ЦІЛОЮ.
            sample_t local = mbx_data;      // єдине, цілісне копіювання

            __asm volatile ("" ::: "memory");
            mbx_ack = true;                 // фаза 2: підтверджуємо прийом

            // Обробляємо СВОЮ копію — mbx_data вже вільна для ISR.
            process_sample(&local);
        }

        // Завершуємо коло: коли ISR зняв req, знімаємо й ack.
        if (!mbx_req && mbx_ack) {
            mbx_ack = false;                // фаза 4
        }

        do_other_work();
    }
}

// ── Друга половина машини A — у наступному вході ISR ─────────────────────
// Фазу 3 (зняти req по ack) робимо на початку кожного переривання,
// щоб не крутити зайнятого очікування всередині ISR.
void sensor_isr_prologue(void) {
    if (mbx_req && mbx_ack) {
        mbx_req = false;    // фаза 3: головний цикл підтвердив — знімаємо запит
    }
}
