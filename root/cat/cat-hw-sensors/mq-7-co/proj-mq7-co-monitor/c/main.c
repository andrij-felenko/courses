#include "mq7.h"
#include <stdio.h>

// Глобальний об'єкт давача
mq7_sensor_t mq7;

// --- HAL (Hardware Abstraction Layer) ---
// У реальному проєкті тут будуть виклики специфічні для конкретного мікроконтролера
// (наприклад, STM32 HAL, ESP-IDF або звернення до регістрів AVR)

uint32_t system_time_ms = 0;

uint32_t hal_get_time_ms(void) {
    // Повертає системний час у мілісекундах (зазвичай через SysTick або інший таймер)
    return system_time_ms;
}

void hal_pwm_set_duty(uint8_t duty) {
    // Встановлення ШІМ на піні транзистора, що керує нагрівачем
    // (0 - вимкнено, 255 - максимум)
}

uint16_t hal_adc_read(void) {
    // Зчитування 10-бітного АЦП з піна AOUT давача
    return 512; // Заглушка для прикладу
}

void hal_buzzer_set(bool state) {
    // Встановлення стану GPIO піна, до якого підключено бузер
}
// ----------------------------------------

int main(void) {
    // Ініціалізація периферії: таймери, ШІМ, АЦП, GPIO
    // hal_hardware_init();
    
    // Ініціалізація автомата станів MQ-7
    mq7_init(&mq7);
    
    while (1) {
        // Оновлення FSM. Цей виклик не блокує потік!
        if (mq7_update(&mq7)) {
            // Щоразу по завершенні повного циклу (60с + 90с) отримуємо нове значення
            printf("CO Концентрація: %.2f ppm\n", mq7.ppm);
            if (mq7.alarm_active) {
                printf("УВАГА! Небезпечний рівень CO!\n");
            }
        }
        
        // Тут можуть вільно виконуватись інші задачі, наприклад:
        // poll_network();
        // update_display();
        
        // Для симуляції часу в цьому прикладі:
        system_time_ms += 10;
        // sleep_ms(10);
    }

    return 0;
}
