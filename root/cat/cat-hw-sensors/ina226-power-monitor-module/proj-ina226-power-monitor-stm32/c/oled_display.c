#include "oled_display.h"
#include <stdio.h>
#include <string.h>

// Шрифтова таблиця 5x7 ASCII (символи від 0x20 ' ' до 0x7E '~')
static const uint8_t font5x7[][5] = {
    {0x00, 0x00, 0x00, 0x00, 0x00}, // Space
    {0x00, 0x00, 0x5F, 0x00, 0x00}, // !
    {0x00, 0x07, 0x00, 0x07, 0x00}, // "
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    {0x02, 0x01, 0x02, 0x04, 0x02}, // ~
};

// Відправка команди розпізнавання контролеру SSD1306
static bool oled_send_command(oled_t *oled, uint8_t cmd) {
    if (!oled || !oled->i2c_write) return false;
    uint8_t buf[2] = {0x00, cmd}; // 0x00 = байт команди
    return oled->i2c_write(oled->i2c_addr, buf, 2);
}

bool oled_init(oled_t *oled, uint8_t i2c_addr, oled_i2c_write_fn write_fn) {
    if (!oled || !write_fn) return false;

    oled->i2c_addr = i2c_addr;
    oled->i2c_write = write_fn;
    memset(oled->buffer, 0, sizeof(oled->buffer));

    // Послідовність ініціалізації контролера SSD1306
    static const uint8_t init_cmds[] = {
        0xAE,       // Вимкнути дисплей (Display OFF)
        0xD5, 0x80, // Налаштувати частоту осцилятора та дільника
        0xA8, 0x3F, // Мультиплексор 1/64
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        0xA6,       // Нормальний режим відображення (не інверсний)
        0xAF        // Увімкнути дисплей (Display ON)
    };

    for (size_t i = 0; i < sizeof(init_cmds); i++) {
        if (!oled_send_command(oled, init_cmds[i])) {
            return false;
        }
    }

    oled_clear(oled);
    return oled_update(oled);
}

void oled_clear(oled_t *oled) {
    if (!oled) return;
    memset(oled->buffer, 0, sizeof(oled->buffer));
}

bool oled_update(oled_t *oled) {
    if (!oled || !oled->i2c_write) return false;

    // Встановлення діапазону колонок (0..127)
    oled_send_command(oled, 0x21);
    oled_send_command(oled, 0);
    oled_send_command(oled, OLED_WIDTH - 1);

    // Встановлення діапазону сторінок (0..7)
    oled_send_command(oled, 0x22);
    oled_send_command(oled, 0);
    oled_send_command(oled, (OLED_HEIGHT / 8) - 1);

    // Передача кадрового буфера з префіксом 0x40 (потік даних RAM)
    uint8_t payload[1 + OLED_BUFFER_SIZE];
    payload[0] = 0x40; // 0x40 = префікс даних
    memcpy(&payload[1], oled->buffer, OLED_BUFFER_SIZE);

    return oled->i2c_write(oled->i2c_addr, payload, sizeof(payload));
}

void oled_draw_pixel(oled_t *oled, int x, int y, bool color) {
    if (!oled || x < 0 || x >= OLED_WIDTH || y < 0 || y >= OLED_HEIGHT) return;

    uint32_t index = x + (y / 8) * OLED_WIDTH;
    uint8_t bit = y % 8;

    if (color) {
        oled->buffer[index] |= (1U << bit);
    } else {
        oled->buffer[index] &= ~(1U << bit);
    }
}

void oled_draw_char(oled_t *oled, int x, int y, char c, bool color) {
    if (!oled) return;
    if (c < ' ' || c > '~') c = '?';

    uint32_t font_idx = c - ' ';
    for (int col = 0; col < 5; col++) {
        uint8_t line = font5x7[font_idx][col];
        for (int row = 0; row < 7; row++) {
            if (line & (1U << row)) {
                oled_draw_pixel(oled, x + col, y + row, color);
            } else {
                oled_draw_pixel(oled, x + col, y + row, !color);
            }
        }
    }
    // Міжсимвольний інтервал (1 піксель)
    for (int row = 0; row < 7; row++) {
        oled_draw_pixel(oled, x + 5, y + row, !color);
    }
}

void oled_draw_string(oled_t *oled, int x, int y, const char *str, bool color) {
    if (!oled || !str) return;
    int curr_x = x;
    while (*str) {
        if (curr_x + 6 > OLED_WIDTH) break; // Межа екрана
        oled_draw_char(oled, curr_x, y, *str, color);
        curr_x += 6;
        str++;
    }
}

void oled_display_measurements(oled_t *oled, uint32_t bus_voltage_mv, int32_t current_ma, uint32_t power_mw, bool alert_active) {
    if (!oled) return;

    oled_clear(oled);

    // Рядок 0: Заголовок пристрою
    oled_draw_string(oled, 8, 0, "INA226 MONITOR", true);
    oled_draw_string(oled, 0, 10, "--------------------", true);

    // Рядок 2: Напруга шини (V)
    char buf[32];
    uint32_t v_int = bus_voltage_mv / 1000;
    uint32_t v_dec = bus_voltage_mv % 1000;
    snprintf(buf, sizeof(buf), "Vbus:  %lu.%03lu V", (unsigned long)v_int, (unsigned long)v_dec);
    oled_draw_string(oled, 0, 22, buf, true);

    // Рядок 3: Струм (мА)
    char sign = ' ';
    int32_t abs_curr = current_ma;
    if (current_ma < 0) {
        sign = '-';
        abs_curr = -current_ma;
    }
    snprintf(buf, sizeof(buf), "Curr: %c%ld mA", sign, (long)abs_curr);
    oled_draw_string(oled, 0, 34, buf, true);

    // Рядок 4: Потужність (Вт)
    uint32_t p_int = power_mw / 1000;
    uint32_t p_dec = power_mw % 1000;
    snprintf(buf, sizeof(buf), "Power: %lu.%03lu W", (unsigned long)p_int, (unsigned long)p_dec);
    oled_draw_string(oled, 0, 46, buf, true);

    // Рядок 6: Статус апаратного переривання ALERT
    if (alert_active) {
        oled_draw_string(oled, 0, 56, "ALERT: LIMIT EXCEEDED", true);
    } else {
        oled_draw_string(oled, 0, 56, "Status: NORMAL", true);
    }

    oled_update(oled);
}
