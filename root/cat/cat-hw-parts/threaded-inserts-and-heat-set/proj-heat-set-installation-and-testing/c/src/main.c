#include "hx711_pullout.h"
#include <stdio.h>

int main(void) {
    printf("====================================================================\n");
    printf("   МІКРОКОНТРОЛЕРНИЙ МОДУЛЬ ВИПРОБУВАННЯ ВТУЛОК НА ВИРИВАННЯ (HX711)\n");
    printf("====================================================================\n");

    hx711_pullout_t rig_sensor;
    /* SCK = GPIO 4, DOUT = GPIO 5, коефіцієнт = 412.5 відліків/Н, alpha = 0.3 */
    hx711_init(&rig_sensor, 4, 5, 412.5f, 0.30f);

    printf("Проведення процедури тарування тензомосту (10 вибірок)...\n");
    hx711_tare(&rig_sensor, 10);
    printf("Тарування завершено. Зсув нуля: %ld відліків АЦП.\n\n", (long)rig_sensor.tare_offset);

    printf("Початок навантажувального циклу стенда. Телеметрія UART:\n");
    printf("--------------------------------------------------------------------\n");
    printf(" Час (мс) | Сире значення | Зусилля (Н) | Пік (Н) | Стан посадки\n");
    printf("--------------------------------------------------------------------\n");

    for (int step = 1; step <= 80; step++) {
        uint32_t timestamp_ms = step * 50; /* інтервал дискретизації 50 мс */
        float force = hx711_update_force(&rig_sensor);
        float peak = hx711_get_peak_force(&rig_sensor);

        const char *status = "Пружна деформація";
        if (force > 520.0f) {
            status = "Пластична плинність";
        }
        if (peak > 580.0f && force < peak * 0.70f) {
            status = "[ЗРИВ ВТУЛКИ]";
        }

        /* Виведення протоколу телеметрії UART */
        if (step % 5 == 0 || force >= 600.0f) {
            printf(" %8u | %13ld | %11.1f | %7.1f | %s\n",
                   timestamp_ms,
                   (long)(rig_sensor.tare_offset + (int32_t)(force * rig_sensor.scale_factor)),
                   force, peak, status);
        }
    }

    printf("--------------------------------------------------------------------\n");
    printf("ПІДСУМОК ВИПРОБУВАННЯ:\n");
    printf(" Максимальне пікове зусилля виривання (Pullout Peak): %.2f Н\n", rig_sensor.peak_force_n);
    if (rig_sensor.peak_force_n >= 500.0f) {
        printf(" ОЦІНКА: [ВІДПОВІДАЄ ТУ] З'єднання витримує розрахункове осьове навантаження.\n");
    } else {
        printf(" ОЦІНКА: [НЕ ВІДПОВІДАЄ ТУ] Низька міцність посадки. Потрібне коригування отвору.\n");
    }
    printf("====================================================================\n");

    return 0;
}
